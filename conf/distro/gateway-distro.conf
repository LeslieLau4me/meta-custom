## conf/distro/gateway-distro.conf
```bitbake
# 裁剪无用功能
DISTRO_FEATURES:remove = " \
    qt qt6 ptest \
    alsa pulseaudio audio sound \
    wayland x11 opengl es2 vulkan gtk \
    gobject-introspection \
    tpm tpm2 virtualization \
"

# 产品必需
DISTRO_FEATURES:append = " systemd ppp usbmodeswitch modemmanager"
INIT_MANAGER = "systemd"

# 优化
DEBUG_BUILD = "0"
INHIBIT_PACKAGE_DEBUG_SPLIT = "1"
INHIBIT_PACKAGE_STRIP = "0"

DISTRO_FEATURES:remove = "rust go"
RUST_ENABLE = "0"
GO_ENABLE = "0"
INHERIT:remove = "rust cargo go"
IMAGE_INSTALL:remove = "rust cargo libstd-rs go golang python3-maturin"
```

## conf/layer.conf
```bitbake
BBPATH .= ":${LAYERDIR}"
BBFILES += "${LAYERDIR}/recipes-*/*/*.bb"
BBFILES += "${LAYERDIR}/recipes-*/*/*.bbappend"

BBFILE_COLLECTIONS += "meta-custom"
BBFILE_PATTERN_meta-custom = "^${LAYERDIR}/"
BBFILE_PRIORITY_meta-custom = "30"
LAYERSERIES_COMPAT_meta-custom = "walnascar"
# 指定默认使用我们自定义的发行版
DISTRO = "gateway-distro"
```
